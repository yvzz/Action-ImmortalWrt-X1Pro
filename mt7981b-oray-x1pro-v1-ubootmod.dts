// SPDX-License-Identifier: (GPL-2.0 OR MIT)

/dts-v1/;
#include "mt7981b-oray-x1pro-v1.dtsi"

/ {
	model = "Oray X1Pro v1 ubi 112M";
	compatible = "oray,x1pro-v1-ubootmod", "mediatek,mt7981";
};

&spi_nand {
	spi-cal-enable;
	spi-cal-mode = "read-data";
	spi-cal-datalen = <7>;
	spi-cal-data = /bits/ 8 <0x53 0x50 0x49 0x4E 0x41 0x4E 0x44>;
	spi-cal-addrlen = <5>;
	spi-cal-addr = /bits/ 32 <0x0 0x0 0x0 0x0 0x0>;

	mediatek,nmbm;
	mediatek,bmt-max-ratio = <1>;
	mediatek,bmt-max-reserved-blocks = <64>;
};

&ubi {
	reg = <0x800000 0x7000000>;
};

&wifi {
	nvmem-cells = <&eeprom_factory_0>, <&macaddr_bdinfo_de00 2>;
	nvmem-cell-names = "eeprom", "mac-address";
};
